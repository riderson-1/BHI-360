## prj.conf
```kconfig
# Enable I2C
# CONFIG_I2C=y

# Enable SPI
# CONFIG_SPI=y
# CONFIG_SPI_2=y

# Enable GPIO
CONFIG_GPIO=y

# Enable logging
CONFIG_LOG=y
CONFIG_LOG_MODE_IMMEDIATE=y

# Enable sensor API
CONFIG_SENSOR=y

# Enable floating point
CONFIG_FPU=y
CONFIG_FP_HARDABI=y

# Enable pin control
CONFIG_PINCTRL=y

# Increase stack sizes
CONFIG_MAIN_STACK_SIZE=4096
CONFIG_SYSTEM_WORKQUEUE_STACK_SIZE=2048

# Added from the code block
CONFIG_NRFX_GPIOTE=y
CONFIG_SPI=y
# CONFIG_NRFX_SPIM3=y
CONFIG_NRFX_CLOCK=y 

# RTT Logging (for J-Link RTT Viewer)
CONFIG_USE_SEGGER_RTT=y
CONFIG_LOG_BACKEND_RTT=y
CONFIG_RTT_CONSOLE=y
```

## src/main.c
```c
#include <zephyr/kernel.h>
#include <zephyr/device.h>
#include <zephyr/drivers/spi.h>
#include <zephyr/drivers/gpio.h>
#include <zephyr/logging/log.h>
#include <stdio.h>
#include "bhy2.h"
#include "bhy2_parse.h"
#include "common.h"
#include "add_imu.h"

#define BHY2_RD_WR_LEN          256 
#define WORK_BUFFER_SIZE        2048

LOG_MODULE_REGISTER(main, CONFIG_LOG_DEFAULT_LEVEL);

#ifdef UPLOAD_FIRMWARE_TO_FLASH
#include "BHY2-Sensor-API/firmware/bhi360/BHI260AP-flash.fw.h"
#else
#include "BHY2-Sensor-API/firmware/bhi360/BHI360_BMM350C.fw.h"
#endif

#define WORK_BUFFER_SIZE  2048
#define QUAT_SENSOR_ID    BHY2_SENSOR_ID_GAMERV  // Use Game Rotation Vector instead
#define LACC_SENSOR_ID    BHY2_SENSOR_ID_ACC  // Use Linear Acceleration sensor ID

#define MAX_IMU_COUNT 4 

// Add new function declarations
static void parse_quaternion(const struct bhy2_fifo_parse_data_info *callback_info, void *callback_ref);
static void parse_linear_acceleration(const struct bhy2_fifo_parse_data_info *callback_info, void *callback_ref);
static void parse_meta_event(const struct bhy2_fifo_parse_data_info *callback_info, void *callback_ref);

static void print_api_error(int8_t rslt, struct bhy2_dev *dev)
{
    if (rslt != BHY2_OK) {
        LOG_ERR("API error: %d", rslt);
        if ((rslt == BHY2_E_IO) && (dev != NULL)) {
            LOG_ERR("Interface error: %d", dev->hif.intf_rslt);
            dev->hif.intf_rslt = BHY2_INTF_RET_SUCCESS;
        }
    }
}

static int8_t upload_firmware(struct bhy2_dev *dev)
{
    uint32_t incr = 256; /* Max command packet size */
    uint32_t len = sizeof(bhy2_firmware_image);
    int8_t rslt = BHY2_OK;

    if ((incr % 4) != 0) /* Round off to higher 4 bytes */
    {
        incr = ((incr >> 2) + 1) << 2;
    }

    for (uint32_t i = 0; (i < len) && (rslt == BHY2_OK); i += incr)
    {
        if (incr > (len - i)) /* If last payload */
        {
            incr = len - i;
            if ((incr % 4) != 0) /* Round off to higher 4 bytes */
            {
                incr = ((incr >> 2) + 1) << 2;
            }
        }

#ifdef UPLOAD_FIRMWARE_TO_FLASH
        rslt = bhy2_upload_firmware_to_flash_partly(&bhy2_firmware_image[i], i, incr, dev);
#else
        rslt = bhy2_upload_firmware_to_ram_partly(&bhy2_firmware_image[i], len, i, incr, dev);
#endif

        LOG_INF("%.2f%% complete", (float)(i + incr) / (float)len * 100.0f);
    }

    return rslt;
}

// Delay function for BHY2 driver
static void bhi360_delay_us(uint32_t period_us, void *intf_ptr)
{
    k_usleep(period_us);
}

// Function to initialize a single IMU
static bool initialize_imu(imu_device_t *imu) {
    int8_t rslt;
    uint8_t product_id = 0;
    uint16_t version = 0;
    uint8_t hintr_ctrl, hif_ctrl, boot_status;

    LOG_INF("%s: Starting initialization", imu->name);

    // Initialize BHY2 device
    rslt = bhy2_init(BHY2_SPI_INTERFACE,
                     bhi360_spi_read,
                     bhi360_spi_write,
                     bhi360_delay_us,
                     BHY2_RD_WR_LEN,
                     imu,  // Pass IMU struct as interface pointer
                     &imu->bhy2);
    if (rslt != BHY2_OK) {
        LOG_ERR("%s: Initialization failed", imu->name);
        return false;
    }

    // Soft reset
    rslt = bhy2_soft_reset(&imu->bhy2);
    if (rslt != BHY2_OK) {
        LOG_ERR("%s: Soft reset failed", imu->name);
        return false;
    }

    // Product ID check with retries
    bool id_read_success = false;
    for (int retry = 0; retry < 20; retry++) {
        rslt = bhy2_get_product_id(&product_id, &imu->bhy2);
        if (rslt == BHY2_OK && product_id == BHY2_PRODUCT_ID) {
            LOG_INF("%s: Product ID verified on attempt %d", imu->name, retry + 1);
            id_read_success = true;
            break;
        }
        k_msleep(10);
    }
    
    if (!id_read_success) {
        LOG_ERR("%s: Failed to verify product ID", imu->name);
        return false;
    }

    // Configure FIFO and interrupts
    hintr_ctrl = BHY2_ICTL_DISABLE_STATUS_FIFO | BHY2_ICTL_DISABLE_DEBUG;
    rslt = bhy2_set_host_interrupt_ctrl(hintr_ctrl, &imu->bhy2);
    
    hif_ctrl = 0;
    rslt = bhy2_set_host_intf_ctrl(hif_ctrl, &imu->bhy2);

    // Check boot status and upload firmware
    rslt = bhy2_get_boot_status(&boot_status, &imu->bhy2);
    if (boot_status & BHY2_BST_HOST_INTERFACE_READY) {
        LOG_INF("%s: Uploading firmware", imu->name);
        rslt = upload_firmware(&imu->bhy2);
        if (rslt != BHY2_OK) {
            LOG_ERR("%s: Firmware upload failed", imu->name);
            return false;
        }

        // Boot from RAM and verify
        rslt = bhy2_boot_from_ram(&imu->bhy2);
        rslt = bhy2_get_kernel_version(&version, &imu->bhy2);
        if (rslt != BHY2_OK || version == 0) {
            LOG_ERR("%s: Boot failed", imu->name);
            return false;
        }
        LOG_INF("%s: Boot successful, kernel version %u", imu->name, version);

        // Update virtual sensor list first
        LOG_INF("%s: Updating virtual sensor list", imu->name);
        rslt = bhy2_update_virtual_sensor_list(&imu->bhy2);
        print_api_error(rslt, &imu->bhy2);

        // Register callbacks
        LOG_INF("%s: Registering callbacks", imu->name);
        
        // Configure sensors
        float sample_rate = 100.0;
        uint32_t report_latency_ms = 0;

        // Configure quaternion sensor
        LOG_INF("%s: Configuring quaternion sensor...", imu->name);
        rslt = bhy2_set_virt_sensor_cfg(QUAT_SENSOR_ID, sample_rate, report_latency_ms, &imu->bhy2);
        print_api_error(rslt, &imu->bhy2);
        LOG_INF("%s: Enable Quaternion at %.2fHz", imu->name, (double)sample_rate);

        // Configure linear acceleration sensor
        LOG_INF("%s: Configuring linear acceleration sensor...", imu->name);
        rslt = bhy2_set_virt_sensor_cfg(LACC_SENSOR_ID, sample_rate, report_latency_ms, &imu->bhy2);
        print_api_error(rslt, &imu->bhy2);
        LOG_INF("%s: Enable Linear Acceleration at %.2fHz", imu->name, sample_rate);

        rslt = bhy2_register_fifo_parse_callback(BHY2_SYS_ID_META_EVENT, 
            parse_meta_event, imu, &imu->bhy2);
        print_api_error(rslt, &imu->bhy2);

        // Check quaternion availability
        LOG_INF("%s: Checking quaternion sensor availability...", imu->name);
        if (!bhy2_is_sensor_available(QUAT_SENSOR_ID, &imu->bhy2)) {
            LOG_ERR("%s: Quaternion sensor not available!", imu->name);
        } else {
            LOG_INF("%s: Quaternion sensor is available", imu->name);
            rslt = bhy2_register_fifo_parse_callback(QUAT_SENSOR_ID, 
                parse_quaternion, imu, &imu->bhy2);
            print_api_error(rslt, &imu->bhy2);
        }

        // Check linear acceleration availability
        LOG_INF("%s: Checking linear acceleration sensor availability...", imu->name);
        if (!bhy2_is_sensor_available(LACC_SENSOR_ID, &imu->bhy2)) {
            LOG_ERR("%s: Linear acceleration sensor not available!", imu->name);
        } else {
            LOG_INF("%s: Linear acceleration sensor is available", imu->name);
            rslt = bhy2_register_fifo_parse_callback(LACC_SENSOR_ID, 
                parse_linear_acceleration, imu, &imu->bhy2);
            print_api_error(rslt, &imu->bhy2);
        }

        imu->initialized = true;
        LOG_INF("%s: Initialization complete", imu->name);
        return true;
    }

    LOG_ERR("%s: Host interface not ready", imu->name);
    return false;
}

int main(void)
{
    LOG_INF("Starting BHI360 firmware upload application");

    // Initialize all IMUs
    for (int i = 0; i < NUM_IMUS; i++) {
        setup_SPI(&imu_devices[i]);  // Setup SPI for each IMU
        initialize_imu(&imu_devices[i]);
    }

    while (1) {
        for (int i = 0; i < NUM_IMUS; i++) {
            if (!imu_devices[i].initialized) {
                continue;
            }

            uint8_t work_buffer[WORK_BUFFER_SIZE];
            int8_t rslt = bhy2_get_and_process_fifo(work_buffer, 
                                                   sizeof(work_buffer),
                                                   &imu_devices[i].bhy2);
            if (rslt != BHY2_OK) {
                LOG_WRN("%s: FIFO processing error", imu_devices[i].name);
            }
        }
        // k_msleep(10);
    }
    return 0;
}

// Update callback functions to use IMU context
static void parse_quaternion(const struct bhy2_fifo_parse_data_info *callback_info, void *callback_ref)
{
    imu_device_t *imu = (imu_device_t *)callback_ref;
    struct bhy2_data_quaternion data;
    uint32_t s, ns;
    
    if (callback_info->data_size != 11) { // Check for valid payload size
        LOG_ERR("Invalid data size: %d", callback_info->data_size);
        return;
    }

    bhy2_parse_quaternion(callback_info->data_ptr, &data);

    uint64_t timestamp = *callback_info->time_stamp;
    timestamp = timestamp * 15625; // Convert to nanoseconds
    s = (uint32_t)(timestamp / UINT64_C(1000000000));
    ns = (uint32_t)(timestamp - (s * UINT64_C(1000000000)));

    LOG_INF("%s QUAT: T: %u.%09u; x: %f, y: %f, z: %f, w: %f; acc: %.2f",
            imu->name,
            s,
            ns,
            data.x / 16384.0f,
            data.y / 16384.0f,
            data.z / 16384.0f,
            data.w / 16384.0f,
            ((data.accuracy * 180.0f) / 16384.0f) / 3.141592653589793f);
}

static void parse_linear_acceleration(const struct bhy2_fifo_parse_data_info *callback_info, void *callback_ref) {
    imu_device_t *imu = (imu_device_t *)callback_ref;
    struct bhy2_data_xyz data;
    bhy2_parse_xyz(callback_info->data_ptr, &data);
    LOG_INF("%s Linear Acceleration: x: %d, y: %d, z: %d",
            imu->name,
            data.x,
            data.y,
            data.z);
}

static void parse_meta_event(const struct bhy2_fifo_parse_data_info *callback_info, void *callback_ref)
{
    (void)callback_ref;
    uint8_t meta_event_type = callback_info->data_ptr[0];
    uint8_t byte1 = callback_info->data_ptr[1];
    uint8_t byte2 = callback_info->data_ptr[2];
    char *event_text;

    if (callback_info->sensor_id == BHY2_SYS_ID_META_EVENT)
    {
        event_text = "[META EVENT]";
    }
    else if (callback_info->sensor_id == BHY2_SYS_ID_META_EVENT_WU)
    {
        event_text = "[META EVENT WAKE UP]";
    }
    else
    {
        return;
    }

    switch (meta_event_type)
    {
        case BHY2_META_EVENT_FLUSH_COMPLETE:
            LOG_INF("%s Flush complete for sensor id %u", event_text, byte1);
            break;
        case BHY2_META_EVENT_SAMPLE_RATE_CHANGED:
            LOG_INF("%s Sample rate changed for sensor id %u", event_text, byte1);
            break;
        case BHY2_META_EVENT_POWER_MODE_CHANGED:
            LOG_INF("%s Power mode changed for sensor id %u", event_text, byte1);
            break;
        case BHY2_META_EVENT_ALGORITHM_EVENTS:
            LOG_INF("%s Algorithm event", event_text);
            break;
        case BHY2_META_EVENT_SENSOR_STATUS:
            LOG_INF("%s Accuracy for sensor id %u changed to %u", event_text, byte1, byte2);
            break;
        case BHY2_META_EVENT_BSX_DO_STEPS_MAIN:
            LOG_INF("%s BSX event (do steps main)", event_text);
            break;
        case BHY2_META_EVENT_BSX_DO_STEPS_CALIB:
            LOG_INF("%s BSX event (do steps calib)", event_text);
            break;
        case BHY2_META_EVENT_BSX_GET_OUTPUT_SIGNAL:
            LOG_INF("%s BSX event (get output signal)", event_text);
            break;
        case BHY2_META_EVENT_SENSOR_ERROR:
            LOG_INF("%s Sensor id %u reported error 0x%02X", event_text, byte1, byte2);
            break;
        case BHY2_META_EVENT_FIFO_OVERFLOW:
            LOG_INF("%s FIFO overflow", event_text);
            break;
        case BHY2_META_EVENT_DYNAMIC_RANGE_CHANGED:
            LOG_INF("%s Dynamic range changed for sensor id %u", event_text, byte1);
            break;
        case BHY2_META_EVENT_FIFO_WATERMARK:
            LOG_INF("%s FIFO watermark reached", event_text);
            break;
        case BHY2_META_EVENT_INITIALIZED:
            LOG_INF("%s Firmware initialized. Firmware version %u", event_text, ((uint16_t)byte2 << 8) | byte1);
            break;
        case BHY2_META_TRANSFER_CAUSE:
            LOG_INF("%s Transfer cause for sensor id %u", event_text, byte1);
            break;
        case BHY2_META_EVENT_SENSOR_FRAMEWORK:
            LOG_INF("%s Sensor framework event for sensor id %u", event_text, byte1);
            break;
        case BHY2_META_EVENT_RESET:
            LOG_INF("%s Reset event", event_text);
            break;
        case BHY2_META_EVENT_SPACER:
            break;
        default:
            LOG_INF("%s Unknown meta event with id: %u", event_text, meta_event_type);
            break;
    }
}
```

## src/add_imu.h
```c
#include <zephyr/devicetree.h>
#include <zephyr/drivers/spi.h>
#include <zephyr/drivers/gpio.h>

#define IMU_MAIN_NODE   DT_NODELABEL(imu_main)
#define IMU_RESET_NODE  DT_NODELABEL(reset_imu_main)

static imu_device_t imu_devices[] = {
    {
        .spi_spec = SPI_DT_SPEC_GET(IMU_MAIN_NODE, SPI_WORD_SET(8) | SPI_TRANSFER_MSB),
        .int_pin = GPIO_DT_SPEC_GET(IMU_MAIN_NODE, int_gpios),
        .reset_pin = GPIO_DT_SPEC_GET(IMU_RESET_NODE, gpios),
        .initialized = false,
        .name = "IMU_MAIN"
    }
};

#define NUM_IMUS (sizeof(imu_devices) / sizeof(imu_devices[0]))
```

## src/common.c
```c
#include "common.h"
#include <zephyr/logging/log.h>
#include <string.h>

LOG_MODULE_DECLARE(main);

void setup_SPI(imu_device_t *imu)
{
    int ret;

    // Verify SPI device is available
    if (!device_is_ready(imu->spi_spec.bus)) {
        LOG_ERR("%s: SPI bus not ready", imu->name);
        return;
    }

    // Configure interrupt pin as input
    if (imu->int_pin.port != NULL) {
        ret = gpio_pin_configure_dt(&imu->int_pin, GPIO_INPUT);
        if (ret < 0) {
            LOG_ERR("%s: Failed to configure INT pin: %d", imu->name, ret);
        } else {
            LOG_INF("%s: INT pin configured at P%u.%02u", 
                    imu->name,
                    (imu->int_pin.pin >> 5) & 1,
                    imu->int_pin.pin & 0x1F);
        }
    }

    // Release reset (set to inactive - HIGH for GPIO_ACTIVE_LOW)
    if (imu->reset_pin.port != NULL) {
        ret = gpio_pin_configure_dt(&imu->reset_pin, GPIO_OUTPUT_INACTIVE);
        if (ret < 0) {
            LOG_ERR("%s: Failed to configure reset pin: %d", imu->name, ret);
        } else {
            LOG_INF("%s: Reset pin released (inactive)", imu->name);
        }
    }

    LOG_INF("%s: SPI bus configured (8MHz)", imu->name);
}

int8_t bhi360_spi_read(uint8_t reg_addr, uint8_t *reg_data, uint32_t length, void *intf_ptr)
{
    imu_device_t *imu = (imu_device_t *)intf_ptr;
    int ret;

    uint8_t m_tx_buf[1] = {reg_addr | 0x80};
    uint8_t m_rx_buf[length + 1];

    // Perform SPI read (read address with MSB set, then read data)
    const struct spi_buf tx_buf = {.buf = m_tx_buf, .len = sizeof(m_tx_buf)};
    const struct spi_buf_set tx = {.buffers = &tx_buf, .count = 1};

    struct spi_buf rx_buf = {.buf = m_rx_buf, .len = sizeof(m_rx_buf)};
    const struct spi_buf_set rx = {.buffers = &rx_buf, .count = 1};

    ret = spi_transceive_dt(&imu->spi_spec, &tx, &rx);
    if (ret < 0) {
        LOG_ERR("%s: SPI read failed: %d", imu->name, ret);
        return -1;
    }

    // Copy data, skipping first byte (address echo)
    memcpy(reg_data, &m_rx_buf[1], length);

    return BHY2_INTF_RET_SUCCESS;
}

int8_t bhi360_spi_write(uint8_t reg_addr, const uint8_t *reg_data, uint32_t length, void *intf_ptr)
{
    imu_device_t *imu = (imu_device_t *)intf_ptr;
    int ret;

    uint8_t m_tx_buf[length + 1];
    m_tx_buf[0] = reg_addr;
    memcpy(m_tx_buf + 1, reg_data, length);

    const struct spi_buf tx_buf = {.buf = m_tx_buf, .len = sizeof(m_tx_buf)};
    const struct spi_buf_set tx = {.buffers = &tx_buf, .count = 1};

    ret = spi_transceive_dt(&imu->spi_spec, &tx, NULL);
    if (ret < 0) {
        LOG_ERR("%s: SPI write failed: %d", imu->name, ret);
        return -1;
    }

    return BHY2_INTF_RET_SUCCESS;
}

const char *get_api_error(int8_t error_code)
{
    switch (error_code)
    {
        case BHY2_OK: return "BHY2_OK";
        case BHY2_E_NULL_PTR: return "BHY2_E_NULL_PTR";
        case BHY2_E_INVALID_PARAM: return "BHY2_E_INVALID_PARAM";
        case BHY2_E_IO: return "BHY2_E_IO";
        case BHY2_E_MAGIC: return "BHY2_E_MAGIC";
        case BHY2_E_TIMEOUT: return "BHY2_E_TIMEOUT";
        case BHY2_E_BUFFER: return "BHY2_E_BUFFER";
        default: return "Unknown error code";
    }
}

const char *get_sensor_error_text(uint8_t sensor_error)
{
    switch (sensor_error)
    {
        case 0: return "No error";
        default: return "Unknown sensor error";
    }
}

const char *get_sensor_name(uint8_t sensor_id)
{
    switch (sensor_id)
    {
        case BHY2_SENSOR_ID_RV: return "Rotation Vector";
        default: return "Unknown sensor";
    }
}
```

## src/common.h
```c
/**
 * Copyright (c) 2023 Bosch Sensortec GmbH. All rights reserved.
 *
 * BSD-3-Clause
 *
 * Redistribution and use in source and binary forms, with or without
 * modification, are permitted provided that the following conditions are met:
 *
 * 1. Redistributions of source code must retain the above copyright
 *    notice, this list of conditions and the following disclaimer.
 *
 * 2. Redistributions in binary form must reproduce the above copyright
 *    notice, this list of conditions and the following disclaimer in the
 *    documentation and/or other materials provided with the distribution.
 *
 * 3. Neither the name of the copyright holder nor the names of its
 *    contributors may be used to endorse or promote products derived from
 *    this software without specific prior written permission.
 *
 * THIS SOFTWARE IS PROVIDED BY THE COPYRIGHT HOLDERS AND CONTRIBUTORS
 * "AS IS" AND ANY EXPRESS OR IMPLIED WARRANTIES, INCLUDING, BUT NOT
 * LIMITED TO, THE IMPLIED WARRANTIES OF MERCHANTABILITY AND FITNESS
 * FOR A PARTICULAR PURPOSE ARE DISCLAIMED. IN NO EVENT SHALL THE
 * COPYRIGHT HOLDER OR CONTRIBUTORS BE LIABLE FOR ANY DIRECT, INDIRECT,
 * INCIDENTAL, SPECIAL, EXEMPLARY, OR CONSEQUENTIAL DAMAGES
 * (INCLUDING, BUT NOT LIMITED TO, PROCUREMENT OF SUBSTITUTE GOODS OR
 * SERVICES; LOSS OF USE, DATA, OR PROFITS; OR BUSINESS INTERRUPTION)
 * HOWEVER CAUSED AND ON ANY THEORY OF LIABILITY, WHETHER IN CONTRACT,
 * STRICT LIABILITY, OR TORT (INCLUDING NEGLIGENCE OR OTHERWISE) ARISING
 * IN ANY WAY OUT OF THE USE OF THIS SOFTWARE, EVEN IF ADVISED OF THE
 * POSSIBILITY OF SUCH DAMAGE.
 *
 * @file    common.h
 */

#ifndef COMMON_H_
#define COMMON_H_

#include <stdint.h>
#include <stdlib.h>
#include <stdio.h>
#include <zephyr/drivers/spi.h>
#include <zephyr/drivers/gpio.h>
#include <zephyr/logging/log.h>
#include "bhy2.h"

#ifdef __cplusplus
extern "C" {
#endif

// Structure to hold IMU specific data
typedef struct {
    struct spi_dt_spec spi_spec;
    struct gpio_dt_spec int_pin;
    struct gpio_dt_spec reset_pin;
    struct bhy2_dev bhy2;
    bool initialized;
    char name[32];  // Friendly name for logging
} imu_device_t;

// GPIO pin definitions now come from device tree

// Error check macro
#define APP_ERROR_CHECK(err_code) \
    do { \
        if ((err_code) != 0) { \
            LOG_ERR("Error %d at line %d", (err_code), __LINE__); \
        } \
    } while (0)

const char *get_api_error(int8_t error_code);
const char *get_sensor_error_text(uint8_t sensor_error);
const char *get_sensor_name(uint8_t sensor_id);
void setup_SPI(imu_device_t *imu);
int8_t bhi360_spi_read(uint8_t reg_addr, uint8_t *reg_data, uint32_t length, void *intf_ptr);
int8_t bhi360_spi_write(uint8_t reg_addr, const uint8_t *reg_data, uint32_t length, void *intf_ptr);

#ifdef __cplusplus
}
#endif

#endif /* COMMON_H_ */ 
```
